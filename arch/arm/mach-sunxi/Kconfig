## sound/soc/sunxi/sunxi-rpaf/sunxi-hifi/Kconfig
```kconfig
# AudioCodec Interface
config SND_SUNXI_SOC_HIFI_CODEC
	tristate

config SND_SUNXI_SOC_HIFI_CPUDAI
	tristate

# Digital Audio(I2S/PCM/TDM)
config SND_SUNXI_SOC_HIFI_DAUDIO
	tristate

# DMIC Audio Interface
config SND_SUNXI_SOC_HIFI_DMIC
	tristate

# SUNXI Platform HIFI
config SND_SUNXI_SOC_HIFI
	tristate

config SND_SUNXI_HIFI
	bool
	default y if SND_SUNXI_RPAF

# AudioCodec Machine Select
config SND_SUNXI_HIFI_CODEC
	tristate "Allwinner Audio Codec HiFi Support"
	select SND_SUNXI_SOC_HIFI
	select SND_SOC_GENERIC_DMAENGINE_PCM
	select SND_SUNXI_SOC_HIFI_CODEC
	select SND_SUNXI_SOC_HIFI_CPUDAI
	select SND_SUN8IW20_CODEC
	select SND_SUNXI_SOC_SUN8IW20_CODEC
	depends on SND_SUNXI_HIFI
	help
		Select Y or M to add support for AudioCodec Module in the
		Allwinner SoCs.

# Daudio Machine Select
config SND_SUNXI_HIFI_DAUDIO
	tristate "Allwinner Digital Audio HiFi Support"
	select SND_SUNXI_SOC_HIFI
	select SND_SOC_GENERIC_DMAENGINE_PCM
	select SND_SUNXI_SOC_HIFI_DAUDIO
	select SND_SUNXI_SOC_HIFI_SIMPLE_CARD
	select SND_SUNXI_SOC_SIMPLE_CARD
	select SND_SUNXI_SOC_DAUDIO
	depends on SND_SUNXI_HIFI
	help
		Select Y or M to add support for I2S/PCM/TDM Module in the
		Allwinner SoCs.

# DMIC Machine Select
config SND_SUNXI_HIFI_DMIC
	tristate "Allwinner DMIC Support"
	select SND_SUNXI_SOC_HIFI
	select SND_SOC_GENERIC_DMAENGINE_PCM
	select SND_SUNXI_SOC_HIFI_DMIC
	select SND_SUNXI_SOC_HIFI_SIMPLE_CARD
	select SND_SUNXI_SOC_SIMPLE_CARD
	select SND_SUNXI_SOC_DMIC
	depends on SND_SUNXI_HIFI
	help
		Select Y or M to add support DMIC Module in Allwinner
		SoCs.
```
