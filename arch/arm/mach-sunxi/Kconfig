## arch/arm/mach-sunxi/Kconfig
```kconfig
# SPDX-License-Identifier: GPL-2.0-only
menuconfig ARCH_SUNXI
	bool "Allwinner SoCs"
	depends on ARCH_MULTI_V5 || ARCH_MULTI_V7
	select ARCH_HAS_RESET_CONTROLLER
	select CLKSRC_MMIO
	select GENERIC_IRQ_CHIP
	select GPIOLIB
	select PINCTRL
	select PM_OPP
	select SUN4I_TIMER
	select RESET_CONTROLLER
	help
	  Support for Allwinner ARM-based family of processors

if ARCH_SUNXI

if ARCH_MULTI_V7

config MACH_SUN4I
	bool "Allwinner A10 (sun4i) SoCs support"
	default ARCH_SUNXI

config MACH_SUN5I
	bool "Allwinner A10s / A13 (sun5i) SoCs support"
	default ARCH_SUNXI
	select SUN5I_HSTIMER

config MACH_SUN6I
	bool "Allwinner A31 (sun6i) SoCs support"
	default ARCH_SUNXI
	select ARM_GIC
	select MFD_SUN6I_PRCM
	select SUN5I_HSTIMER

config MACH_SUN7I
	bool "Allwinner A20 (sun7i) SoCs support"
	default ARCH_SUNXI
	select ARM_GIC
	select ARM_PSCI
	select ARCH_SUPPORTS_BIG_ENDIAN
	select HAVE_ARM_ARCH_TIMER
	select SUN5I_HSTIMER

config MACH_SUN8I
	bool "Allwinner sun8i Family SoCs support"
	default ARCH_SUNXI
	select ARM_GIC
	select MFD_SUN6I_PRCM

config MACH_SUN9I
	bool "Allwinner (sun9i) SoCs support"
	default ARCH_SUNXI
	select ARM_GIC

config ARCH_SUNXI_MC_SMP
	bool
	depends on SMP
	default MACH_SUN9I || MACH_SUN8I
	select ARM_CCI400_PORT_CTRL
	select ARM_CPU_SUSPEND

endif

if ARCH_MULTI_V5

config MACH_SUNIV
	bool "Allwinner ARMv5 F-series (suniv) SoCs support"
	default ARCH_SUNXI
	help
	  Support for Allwinner suniv ARMv5 SoCs.
	  (F1C100A, F1C100s, F1C200s, F1C500, F1C600)

endif

choice
	prompt "Select the architecture of SoC"
	default ARCH_SUN8I
	help
	  Select the architecture for SoC
	  sunxi
	  `-- sun8i ----- Cortex-A7 based Family SoCs

config ARCH_SUN8I
	bool "Allwinner A7 smp SoCs"
	select ARM_GIC
	select CPU_V7
	select HAVE_SMP
	select HAVE_ARM_ARCH_TIMER
	select SUN4I_TIMER
	select MIGHT_HAVE_CACHE_L2X0
	select PINCTRL
	select PINCTRL_SUNXI
	select ARCH_REQUIRE_GPIOLIB
	select COMMON_CLK
	select CLKDEV_LOOKUP
	select CLKSRC_MMIO
	select CLKSRC_OF
	select GENERIC_CLOCKEVENTS
	select GENERIC_IRQ_CHIP
	select SPARSE_IRQ
	select GENERIC_ALLOCATOR
	help
	  Allwinner A7 smp SoCs(sun8i)
endchoice

# Select the wafer with sun8i

if ARCH_SUN8I
choice
	prompt "Select the wafer with arch sun8i"
	help
	  Select the wafer with arch sun8i

config ARCH_SUN8IW15
        bool "Allwinner sun8iw15 SoCs"
        help
          Allwinner sun8iw15 SoCs

config ARCH_SUN8IW20
        bool "Allwinner sun8iw20 SoCs"
        help
          Allwinner sun8iw20 SoCs

endchoice
endif

# Select the SoC with specific arch and wafer

if ARCH_SUN8IW15
choice
	prompt "Select the SoC with wafer sun8iw15"
	default ARCH_SUN8IW15P1
	help
	 Select the SoC with wafer sun8iw15

config ARCH_SUN8IW15P1
	bool "Allwinner sun8iw15p1 SoC"
	help
	  Allwinner sun8iw15p1 SoC
endchoice
endif

# Select the board between FPGA and EVB

choice
	prompt "Allwinner development Board"
	depends on ARCH_SUNXI
	default FPGA_V4_PLATFORM

config FPGA_V4_PLATFORM
       bool "FPGAv4 board"
       help
         Support for Allwinner's FPGAv4 board

config FPGA_V7_PLATFORM
       bool "FPGAv7 board"
       help
         Support for Allwinner's FPGAv4 board

config EVB_PLATFORM
       bool "EVB board"
       help
         Support for Allwinner's EVB board
endchoice

config SUNXI_SOC_NAME
	string "The name of Sunxi SoC"
	default ""
	help
	  Used for /proc/cpuinfo and /sys/.../sysinfo.

endif
```

## arch/riscv/Kconfig.socs
```kconfig
menu "SoC selection"

config SOC_SIFIVE
       bool "SiFive SoCs"
       select SERIAL_SIFIVE
       select SERIAL_SIFIVE_CONSOLE
       select CLK_SIFIVE
       select CLK_SIFIVE_FU540_PRCI
       select SIFIVE_PLIC
       help
         This enables support for SiFive SoC platform hardware.

config RISCV_SUNXI
       bool

config ARCH_SUNXI
       bool "Allwinner RISC-V SoC Family"
       select RISCV_SUNXI
       select CPU_PM if CPU_IDLE
       help
         This enables support for SUNXI SoC platform hardware.

# Select the board between FPGA and EVB

choice
      prompt "Allwinner development Board"
      depends on ARCH_SUNXI
      default FPGA_V4_PLATFORM

config FPGA_V4_PLATFORM
       bool "FPGAv4 board"
       help
         Support for Allwinner's FPGAv4 board

config FPGA_V7_PLATFORM
       bool "FPGAv7 board"
       help
         Support for Allwinner's FPGAv4 board

config EVB_PLATFORM
       bool "EVB board"
       help
         Support for Allwinner's EVB board
endchoice

if ARCH_SUNXI
choice
	prompt "Select the architecture of SoC"
	default ARCH_SUN20I
	help
	  Select the architecture for SoC
	  sunxi
	  `-- sun20i ----- C906 based Family SoCs

	config ARCH_SUN20I
	bool "Allwinner SUN20I"
endchoice

if ARCH_SUN20I
choice
	prompt "Select the wafer with arch sun20i"
	default ARCH_SUN20IW1
	help
	  Select the wafer with arch sun20i

config ARCH_SUN20IW1
	bool "Allwinner SUN20IW1 SoCs"
	help
	  Support for Allwinner SUN20IW1 SoC family

endchoice
endif

if ARCH_SUN20IW1
choice
	prompt "Select the wafer with arch sun20iw1"
	default ARCH_SUN20IW1P1
	help
	  Select the wafer with arch sun20iw1

config ARCH_SUN20IW1P1
	bool "Allwinner SUN20IW1P1 SoCs"
	help
	  Support for Allwinner SUN20IW1P1 SoC family

endchoice
endif
endif

endmenu
```

## arch/riscv/configs/sun20iw1p1_d1_defconfig
```kconfig
CONFIG_SYSVIPC=y
CONFIG_NO_HZ_IDLE=y
CONFIG_HIGH_RES_TIMERS=y
CONFIG_IKCONFIG=y
CONFIG_IKCONFIG_PROC=y
CONFIG_CGROUPS=y
CONFIG_CGROUP_SCHED=y
CONFIG_CFS_BANDWIDTH=y
CONFIG_CGROUP_BPF=y
CONFIG_NAMESPACES=y
CONFIG_USER_NS=y
CONFIG_CHECKPOINT_RESTORE=y
CONFIG_EXPERT=y
CONFIG_BPF_SYSCALL=y
CONFIG_ARCH_SUNXI=y
CONFIG_EVB_PLATFORM=y
CONFIG_VECTOR=y
CONFIG_CPU_FREQ=y
CONFIG_CPU_FREQ_STAT=y
CONFIG_CPU_FREQ_TIMES=y
CONFIG_CPU_FREQ_GOV_POWERSAVE=y
CONFIG_CPU_FREQ_GOV_USERSPACE=y
CONFIG_CPU_FREQ_GOV_ONDEMAND=y
CONFIG_CPU_FREQ_GOV_CONSERVATIVE=y
CONFIG_CPUFREQ_DT=y
CONFIG_RISCV_ALLWINNER_SUN50I_CPUFREQ_NVMEM=y
CONFIG_MODULES=y
CONFIG_MODULE_UNLOAD=y
CONFIG_CMA=y
CONFIG_NET=y
CONFIG_PACKET=y
CONFIG_UNIX=y
CONFIG_UNIX_DIAG=y
CONFIG_NET_KEY=y
CONFIG_INET=y
CONFIG_IP_MULTICAST=y
CONFIG_IP_ADVANCED_ROUTER=y
CONFIG_IP_FIB_TRIE_STATS=y
CONFIG_IP_MULTIPLE_TABLES=y
CONFIG_CAN=y
CONFIG_CAN_SUN4I=y
CONFIG_DEVTMPFS=y
CONFIG_DEVTMPFS_MOUNT=y
CONFIG_SUNXI_MBUS=y
CONFIG_MTD=y
CONFIG_AW_MTD_SPINAND=y
CONFIG_BLK_DEV_LOOP=y
CONFIG_VIRTIO_BLK=y
CONFIG_SCSI=y
CONFIG_BLK_DEV_SD=y
CONFIG_NETDEVICES=y
CONFIG_SUNXI_GMAC=y
# CONFIG_INPUT_SENSORINIT is not set
CONFIG_KEYBOARD_SUNXI=y
# CONFIG_INPUT_MOUSE is not set
CONFIG_INPUT_SENSOR=y
CONFIG_SUNXI_GPADC=y
CONFIG_SERIAL_EARLYCON_RISCV_SBI=y
CONFIG_VIRTIO_CONSOLE=m
# CONFIG_HW_RANDOM is not set
CONFIG_I2C=y
CONFIG_I2C_CHARDEV=y
CONFIG_I2C_SUNXI=y
CONFIG_SPI=y
CONFIG_SPI_SUNXI=y
CONFIG_PINCTRL=y
CONFIG_POWER_SUPPLY=y
CONFIG_THERMAL=y
CONFIG_THERMAL_STATISTICS=y
CONFIG_THERMAL_WRITABLE_TRIPS=y
CONFIG_THERMAL_EMULATION=y
CONFIG_SUNXI_THERMAL=y
CONFIG_WATCHDOG=y
CONFIG_SUNXI_WATCHDOG=y
CONFIG_MFD_SUN6I_PRCM=y
CONFIG_REGULATOR=y
CONFIG_REGULATOR_FIXED_VOLTAGE=y
CONFIG_SUNXI_REGULATOR_PWM=y
CONFIG_RC_CORE=y
CONFIG_RC_DECODERS=y
CONFIG_IR_NEC_DECODER=y
CONFIG_IR_RC5_DECODER=y
CONFIG_RC_DEVICES=y
CONFIG_IR_RX_SUNXI=y
CONFIG_IR_TX_SUNXI=y
CONFIG_FB=y
CONFIG_DISP2_SUNXI=y
CONFIG_HDMI2_DISP2_SUNXI=y
CONFIG_DISP2_SUNXI_DEBUG=y
CONFIG_BACKLIGHT_CLASS_DEVICE=y
CONFIG_USB=y
CONFIG_USB_EHCI_HCD=y
CONFIG_USB_EHCI_HCD_SUNXI=y
CONFIG_USB_OHCI_HCD=y
CONFIG_USB_OHCI_HCD_SUNXI=y
CONFIG_USB_SUNXI_HCD=y
CONFIG_USB_SUNXI_HCI=y
CONFIG_USB_SUNXI_EHCI0=y
CONFIG_USB_SUNXI_EHCI1=y
CONFIG_USB_SUNXI_OHCI0=y
CONFIG_USB_SUNXI_OHCI1=y
CONFIG_USB_STORAGE=y
CONFIG_USB_STORAGE_REALTEK=y
CONFIG_USB_STORAGE_DATAFAB=y
CONFIG_USB_STORAGE_FREECOM=y
CONFIG_USB_STORAGE_ISD200=y
CONFIG_USB_STORAGE_USBAT=y
CONFIG_USB_STORAGE_SDDR09=y
CONFIG_USB_STORAGE_SDDR55=y
CONFIG_USB_STORAGE_JUMPSHOT=y
CONFIG_USB_STORAGE_ALAUDA=y
CONFIG_USB_STORAGE_ONETOUCH=y
CONFIG_USB_STORAGE_KARMA=y
CONFIG_USB_STORAGE_CYPRESS_ATACB=y
CONFIG_USB_STORAGE_ENE_UB6250=y
CONFIG_USB_UAS=y
CONFIG_USB_GADGET=y
CONFIG_USB_SUNXI_UDC0=y
CONFIG_USB_CONFIGFS=y
CONFIG_USB_CONFIGFS_UEVENT=y
CONFIG_USB_CONFIGFS_SERIAL=y
CONFIG_USB_CONFIGFS_MASS_STORAGE=y
CONFIG_USB_CONFIGFS_F_FS=y
CONFIG_USB_SUNXI_USB=y
CONFIG_USB_SUNXI_USB_MANAGER=y
CONFIG_USB_SUNXI_USB_DEBUG=y
CONFIG_USB_SUNXI_USB_ADB=y
CONFIG_USB_ROLE_SWITCH=y
CONFIG_MMC=y
CONFIG_MMC_SUNXI=y
CONFIG_RTC_CLASS=y
CONFIG_RTC_DRV_SUNXI=y
CONFIG_DMADEVICES=y
CONFIG_DMA_SUN6I=y
CONFIG_SYNC_FILE=y
# CONFIG_VIRTIO_MENU is not set
CONFIG_STAGING=y
CONFIG_ION=y
CONFIG_ION_SYSTEM_HEAP=y
CONFIG_ION_CMA_HEAP=y
# CONFIG_COMMON_CLK_DEBUG is not set
# CONFIG_CLK_SUNXI is not set
CONFIG_SUN8IW20_CCU=y
CONFIG_SUN8IW20_R_CCU=y
CONFIG_SUNXI_IOMMU=y
CONFIG_SUNXI_IOMMU_DEBUG=y
CONFIG_SUNXI_IOMMU_TESTS=y
CONFIG_RPMSG_VIRTIO=y
CONFIG_SUNXI_SID=y
CONFIG_SUNXI_RISCV_SUSPEND=y
CONFIG_PWM=y
CONFIG_PWM_SUNXI_GROUP=y
CONFIG_SIFIVE_PLIC=y
CONFIG_ANDROID=y
CONFIG_NVMEM_SUNXI_SID=y
CONFIG_EXT4_FS=y
CONFIG_EXT4_FS_POSIX_ACL=y
CONFIG_AUTOFS4_FS=y
CONFIG_MSDOS_FS=y
CONFIG_VFAT_FS=y
CONFIG_TMPFS=y
CONFIG_TMPFS_POSIX_ACL=y
CONFIG_UBIFS_FS=y
CONFIG_NLS_CODEPAGE_437=y
CONFIG_NLS_ISO8859_1=y
CONFIG_CRYPTO_USER_API_HASH=y
CONFIG_CRYPTO_USER_API_SKCIPHER=y
CONFIG_CRYPTO_USER_API_RNG=y
CONFIG_CRYPTO_USER_API_AEAD=y
CONFIG_CRYPTO_DEV_SUNXI=y
CONFIG_CRC_ITU_T=y
CONFIG_CRC7=y
CONFIG_XZ_DEC=y
CONFIG_DMA_CMA=y
CONFIG_PRINTK_TIME=y
CONFIG_DEBUG_INFO=y
CONFIG_DEBUG_FS=y
```

## arch/riscv/configs/sun20iw1p1_min_defconfig
```kconfig
CONFIG_SYSVIPC=y
CONFIG_NO_HZ_IDLE=y
CONFIG_HIGH_RES_TIMERS=y
CONFIG_IKCONFIG=y
CONFIG_IKCONFIG_PROC=y
CONFIG_CGROUPS=y
CONFIG_CGROUP_SCHED=y
CONFIG_CFS_BANDWIDTH=y
CONFIG_CGROUP_BPF=y
CONFIG_NAMESPACES=y
CONFIG_USER_NS=y
CONFIG_CHECKPOINT_RESTORE=y
CONFIG_BLK_DEV_INITRD=y
CONFIG_EXPERT=y
CONFIG_BPF_SYSCALL=y
CONFIG_ARCH_SUNXI=y
CONFIG_EVB_PLATFORM=y
CONFIG_VECTOR=y
CONFIG_MODULES=y
CONFIG_MODULE_UNLOAD=y
CONFIG_DEVTMPFS=y
CONFIG_DEVTMPFS_MOUNT=y
CONFIG_BLK_DEV_LOOP=y
CONFIG_VIRTIO_BLK=y
# CONFIG_INPUT_SENSORINIT is not set
# CONFIG_INPUT_KEYBOARD is not set
# CONFIG_INPUT_MOUSE is not set
CONFIG_SERIO_LIBPS2=y
CONFIG_SERIAL_EARLYCON_RISCV_SBI=y
CONFIG_VIRTIO_CONSOLE=m
# CONFIG_HW_RANDOM is not set
CONFIG_PINCTRL=y
# CONFIG_HWMON is not set
CONFIG_MFD_SUN6I_PRCM=y
CONFIG_FB=y
CONFIG_BACKLIGHT_CLASS_DEVICE=y
CONFIG_FRAMEBUFFER_CONSOLE=y
CONFIG_FRAMEBUFFER_CONSOLE_DETECT_PRIMARY=y
# CONFIG_USB_SUPPORT is not set
CONFIG_RTC_CLASS=y
CONFIG_RTC_DRV_SUNXI=y
CONFIG_SYNC_FILE=y
# CONFIG_VIRTIO_MENU is not set
# CONFIG_COMMON_CLK_DEBUG is not set
# CONFIG_CLK_SUNXI is not set
CONFIG_SUN8IW20_CCU=y
CONFIG_SUN8IW20_R_CCU=y
# CONFIG_IOMMU_SUPPORT is not set
CONFIG_RPMSG_VIRTIO=y
# CONFIG_SUNXI_SRAM is not set
CONFIG_SUNXI_RISCV_SUSPEND=y
CONFIG_SIFIVE_PLIC=y
CONFIG_ANDROID=y
CONFIG_EXT4_FS=y
CONFIG_EXT4_FS_POSIX_ACL=y
CONFIG_AUTOFS4_FS=y
CONFIG_MSDOS_FS=y
CONFIG_VFAT_FS=y
CONFIG_TMPFS=y
CONFIG_TMPFS_POSIX_ACL=y
CONFIG_NLS_CODEPAGE_437=y
CONFIG_NLS_ISO8859_1=y
CONFIG_CRYPTO_DEV_VIRTIO=y
CONFIG_CRC_ITU_T=y
CONFIG_CRC7=y
CONFIG_PRINTK_TIME=y
CONFIG_DEBUG_INFO=y
CONFIG_DEBUG_FS=y
```

## drivers/clk/sunxi/Kconfig
```kconfig
# SPDX-License-Identifier: GPL-2.0-only
menuconfig CLK_SUNXI
	tristate "Legacy clock support for Allwinner SoCs"
	depends on ARCH_SUNXI || COMPILE_TEST
	default y

if CLK_SUNXI

config CLK_SUNXI_CLOCKS
	bool "Legacy clock drivers"
	default y
	help
	  Legacy clock drivers being used on older (A10, A13, A20,
	  A23, A31, A80) SoCs. These drivers are kept around for
	  Device Tree backward compatibility issues, in case one would
	  still use a Device Tree with one clock provider by
	  node. Newer Device Trees and newer SoCs use the drivers
	  controlled by CONFIG_SUNXI_CCU.

config CLK_SUNXI_DDR
	tristate "Legacy A100 ddr clock drivers"
	default y
	help
	  Legacy ddr clock drivers being used on A100 SoCs.
	  These drivers are kept around for
	  Device Tree backward compatibility issues, in case one would
	  still use a Device Tree with one clock provider by
	  node. Newer Device Trees and newer SoCs use the drivers
	  controlled by CONFIG_SUNXI_CCU.

config CLK_SUNXI_PRCM_SUN6I
	bool "Legacy A31 PRCM driver"
	select MFD_SUN6I_PRCM
	default y
	help
	  Legacy clock driver for the A31 PRCM clocks. Those are
	  usually needed for the PMIC communication, mostly.

config CLK_SUNXI_PRCM_SUN8I
	bool "Legacy sun8i PRCM driver"
	select MFD_SUN6I_PRCM
	default y
	help
	  Legacy clock driver for the sun8i family PRCM clocks.
	  Those are usually needed for the PMIC communication,
	  mostly.

config CLK_SUNXI_PRCM_SUN9I
	bool "Legacy A80 PRCM driver"
	default y
	help
	  Legacy clock driver for the A80 PRCM clocks. Those are
	  usually needed for the PMIC communication, mostly.

config CLK_SUN8IW15
	tristate "Legacy clock support for sun8iw15p1"
	default y
	depends on ARCH_SUN8IW15
	help
	  Legacy clock driver for sun8iw15p1.

endif
```

## drivers/cpufreq/Kconfig.riscv
```kconfig
# SPDX-License-Identifier: GPL-2.0-only
#
# RISC-V CPU Frequency scaling drivers
#

config RISCV_ALLWINNER_SUN50I_CPUFREQ_NVMEM
	tristate "ARCH RISCV Allwinner nvmem based SUN50I CPUFreq driver"
	depends on ARCH_SUNXI
	depends on NVMEM_SUNXI_SID
	select PM_OPP
	help
	  This adds the nvmem based CPUFreq driver for Allwinner
	  h6 SoC.

	  To compile this driver as a module, choose M here: the
	  module will be called sun50i-cpufreq-nvmem.
```

## drivers/cpuidle/Kconfig.riscv
```kconfig
# SPDX-License-Identifier: GPL-2.0-only
#
# RISCV CPU Idle drivers
#
config RISCV_CPUIDLE
        bool "Generic RISCV CPU idle Driver"
        select DT_IDLE_STATES
	select CPU_IDLE_MULTIPLE_DRIVERS
        help
          Select this to enable generic cpuidle driver for RISCV.
          It provides a generic idle driver whose idle states are configured
          at run-time through DT nodes. The CPUidle suspend backend is
          initialized by calling the CPU operations init idle hook
          provided by architecture code.
```

## drivers/misc/sunxi-gorilla/Kconfig
```kconfig
# SPDX-License-Identifier: GPL-2.0-only

menu "sunxi Gorilla ESL platform"

config SUNXI_GORILLA
	bool "sunxi Gorilla ESL platform support"
	default n
	help
	  sunxi Gorilla ESL platform support

config GORILLA_MEMC
	tristate "Gorilla memory controller driver"
	default n
	depends on SUNXI_GORILLA
	help
	  sunxi Gorilla memory controller driver

config GORILLA_EXTRA_MEM
	tristate "Gorilla extra memory driver"
	default n
	depends on SUNXI_GORILLA
	select GORILLA_MEMC
	help
	  This driver maps physical memory to the kernel. In this way, the
	  memory can be used as a normal storage media from either kernel or
	  user space. In other words, you can read/write the memory just like
	  reading/writing registers. It's useful when you want to access
	  physical memory from user space, e.g. when testing an extra DDR.

config GORILLA_NSI
	tristate "Gorilla NSI driver"
	default n
	depends on SUNXI_GORILLA
	help
	  sunxi Gorilla NSI driver

config GORILLA_DE_TCON
	tristate "Gorilla DE/TCON driver"
	default n
	depends on SUNXI_GORILLA
	help
	  sunxi Gorilla DE/TCON driver

endmenu
```

## drivers/net/wireless/aic8800/aic8800_btsdio/Kconfig
```kconfig
config AIC8800_BTSDIO_SUPPORT
	tristate "AIC8800 bluetooth Support"
	---help---
	  This is support for aic bluetooh driver.
```

## sound/soc/sunxi/sunxi-rpaf/component/Kconfig
```kconfig
#
# Allwinner Built-in DSP Misc Driver.
#
config SND_SUNXI_MISC_HIFI_DSP
	tristate "Allwinner HiFi Component Driver"
	default n
	help
		allwinner built-in dsp component driver.
```
